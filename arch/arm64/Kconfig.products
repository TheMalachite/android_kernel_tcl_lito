## arch/arm64/Kconfig.products
```kconfig
menu "Products selection"
config TCT_LITO_COMMON
	bool "SM7250 TCT COMMON CONFIG"
	depends on ARCH_LITO
	help
	  Support for TCT common device configration.

config TCT_LITO_SEATTLE
	bool "SM7250 TCT SEATTLE"
	depends on ARCH_LITO
	help
	  Support for TCT Seattle device.

config TCT_LITO_OTTAWA
	bool "SM6350 TCT OTTAWA"
	depends on ARCH_LITO
	help
	  Support for TCT Ottawa device.

config TCT_LITO_CHICAGO
	bool "SM7250 TCT CHICAGO"
	depends on ARCH_LITO
	help
	  Support for TCT Chicago device.
endmenu

#[SYSD SYS]begin: add by yange.zhang for task 11024429, 2021-04-14(smartlog)
config TCT_LITO_IRVINE
	bool "SM6350 TCT IRVINE"
	depends on ARCH_LITO
	help
	  Support for TCT Irvine device.
#[SYSD SYS]end: add by yange.zhang for task 11024429, 2021-04-14(smartlog)
```

## drivers/cpuload/Kconfig
```kconfig
config TCT_CPULOAD_NOTI
    bool "notify cpu load"
    default y
    help
      if set, the cpu load will be reported to the cpufeature
```

## drivers/input/fingerprint/focaltech/Kconfig
```kconfig
#
# Focaltech Fingerprint driver configuration
#
config FOCALTECH_FINGERPRINT
	tristate "FocalTech Fingerprint"
	depends on INPUT_FINGERPRINT
	default n
	help
	  If you say Y to this option, support will be included for
	  the FocalTech's fingerprint sensor. This driver supports
	  both REE and TEE.

	  This driver can also be built as a module. If so, the module
	  will be called 'focaltech_fp'.
```

## drivers/input/fingerprint/goodix/Kconfig
```kconfig
config GOODIX_FINGERPRINT
	tristate "generic goodix fingerprint driver"
	depends on INPUT_FINGERPRINT
	default n
	help
	  Say Y here to enable support for goodix fingerprint driver

	  If unsure, say N.

	  To compile this driver as a module, choose M here.
```

## drivers/input/fingerprint/goodix_capcitive/Kconfig
```kconfig
config GOODIX_CAPACIIVE_FINGERPRINT
	tristate "generic goodix fingerprint driver"
	depends on INPUT_FINGERPRINT
	default n
	help
	  Say Y here to enable support for goodix 3626 fingerprint driver

	  If unsure, say N.

	  To compile this driver as a module, choose M here.
```

## drivers/input/fingerprint_HZ/Kconfig
```kconfig
#added by weiqiang.zhou for porting fingerprint

config FINGERPRINT_SUPPORT
    tristate "Fingerprint"
    default n
    help
      If you say Y to this option, support will be included for
      the fingerprint sensor. This driver supports
      both REE and TEE.

config FOCALTECH_FINGERPRINT
    tristate "FocalTech Fingerprint"
    default n
    help
      If you say Y to this option, support will be included for
      the FocalTech's fingerprint sensor. This driver supports
      both REE and TEE.

      This driver can also be built as a module. If so, the module
      will be called 'focaltech_fp'.

config GOODIX_FINGERPRINT
	tristate "generic goodix fingerprint driver"
	default n
	help
	add support for goodix fingerprint driver.
```

## drivers/input/touchscreen/focaltech_touch_ft8756/Kconfig
```kconfig
#
# Focaltech Touchscreen driver configuration
#
if TOUCHSCREEN_IRVINE_FT8756
config TOUCHSCREEN_FT8756
    bool "Focaltech Touchscreen"
    default y
    help
      Say Y here if you have Focaltech touch panel.
      If unsure, say N.
      
config TOUCHSCREEN_FTS_DIRECTORY
    string "Focaltech ts directory name"
    default "focaltech_touch"
    depends on TOUCHSCREEN_FT8756
endif
```

## drivers/misc/aw8695_ottawa/Kconfig
```kconfig
config AW8695_HAPTIC_OTTAWA
    tristate "Haptic driver for awinic AW8695 series"
    depends on I2C
    help
      This option enables support for AW8695 series Haptic Driver.
```

## drivers/misc/tct/Kconfig
```kconfig
config TCT_MISC_DRIVER
	default n
	bool "TCT debug: saving kernel log of booting to memory"
	---help---
	  file node:/proc/bootmsg
```

## drivers/tct/Kconfig
```kconfig
# History 1.0 added by hailong.chen for task 7787483 on 2019-05-23
# History 2.0 added by hailong.chen for task 7805046 on 2019-05-25
# History 3.0 added by hailong.chen for task 9551005 on 2020-07-09

config TCT_DEVICEINFO
	bool "TCT_DEVICEINFO"
	default n
	help
	  Say Y here to enable TCT_DEVICEINFO.

config TCT_UI_TURBO
	bool "ui turbo v1.0"
	default y

config TCT_STAT
	bool "tct statistics feature"
	depends on TCT_UI_TURBO
	default y

config TCT_PERF
	bool "tct performace control device"
	depends on TCT_UI_TURBO
	default y

#config MTK_ROBUST
#	bool "CONFIG_MTK_ROBUST for MediaTek package"
#	default n
#	help
#	It support different type sensor
#	in this platform. If this option
#	is set, it will support ROBUST.

menuconfig TCT
	bool "TCT"
	default n
	help
	  Say Y here to enable TCT.

if TCT

config TCT_DTS
	bool "TCT_DTS"
	default n
	help
	  Say Y here to enable TCT_DTS.

config TCT_PROJECT_IRVINE
	bool "enable irvine project"
	depends on ARCH_LAGOON
	default n
	select TCT_DTS
	help
	  Say Y here to enable TCT_PROJECT_IRVINE.

endif

config TCT_DISPLAY
       bool "Enable tct display"
       default n
```

## kernel/cpu_netlink/Kconfig
```kconfig
config TCT_THREAD_BOOST
    bool "tct binder thread boost"
    default y
    help
      if set, set binder thread to boost group.
```

## net/hkc/Kconfig
```kconfig
config TCT_HKC
    bool "HKC"
    default y
    help
      Enable Hot Key Catching feature if set
```
