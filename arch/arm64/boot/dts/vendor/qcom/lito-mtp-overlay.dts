/dts-v1/;
/plugin/;

#include <dt-bindings/interrupt-controller/arm-gic.h>
#include "lito-mtp.dtsi"
#include "lito-seattle.dtsi" // MODIFIED by hongwei.tian, 2019-08-26,BUG-8279237
/ {
	model = "Qualcomm Technologies, Inc. Lito MTP";
	compatible = "qcom,lito-mtp", "qcom,lito", "qcom,mtp";
	qcom,msm-id = <400 0x10000>, <440 0x10000>;
	qcom,board-id = <8 0>;
};

&ufsphy_mem {
	vdda-phy-always-on;
};
